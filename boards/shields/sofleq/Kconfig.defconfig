## boards/shields/sofleq/Kconfig.defconfig
```kconfig
# Copyright (c) 2020 Ryan Cross
# SPDX-License-Identifier: MIT

if SHIELD_SOFLEQ_LEFT

config ZMK_KEYBOARD_NAME
    default "Sofleq"

config ZMK_SPLIT_ROLE_CENTRAL
    default y

endif

if SHIELD_SOFLEQ_LEFT || SHIELD_SOFLEQ_RIGHT

config ZMK_SPLIT
    default y

endif
```

## boards/shields/sofleq/Kconfig.shield
```kconfig
# Copyright (c) 2020 Ryan Cross
# SPDX-License-Identifier: MIT

config SHIELD_SOFLEQ_LEFT
    def_bool $(shields_list_contains,sofle_left)

config SHIELD_SOFLEQ_RIGHT
    def_bool $(shields_list_contains,sofle_right)
```
